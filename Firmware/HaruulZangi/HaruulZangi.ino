#include <Arduino.h>
#include <Wire.h>
#include <Adafruit_GFX.h>
#include <Adafruit_SSD1306.h>
#include <EEPROM.h>

//==============================================================
// BUZZER ТОХИРГОО
//==============================================================
#define BUZZER_PIN 5

// ТОВЧЛУУРЫН ДУУНЫ ТОХИРГОО
#define NOTE_PUSH    1500
#define NOTE_BUTTON_A 1000
#define NOTE_BUTTON_B 500

// ТОГЛООМЫН ДУУНЫ ТОХИРГОО
#define NOTE_START_1 2000
#define NOTE_START_2 2500
#define NOTE_OVER_1  800
#define NOTE_OVER_2  600
#define NOTE_OVER_3  400


//==============================================================
// CAT3.INO-оос ирсэн үндсэн тодорхойлолтууд
//==============================================================

#define SCREEN_WIDTH 128
#define SCREEN_HEIGHT 64
Adafruit_SSD1306 display(SCREEN_WIDTH, SCREEN_HEIGHT, &Wire, -1);

#define ADC_PIN1 1
#define ADC_PIN 2
#define ADC_BITS 12
#define ADC_ATTEN ADC_11db

// EEPROM хаягууд
#define EEPROM_SIZE 64
#define USERNAME_ADDR 0


// Binary лого зураг
const unsigned char logoBitmap[] PROGMEM = {
 0x00, 0x00, 0x10, 0x00, 0x00, 0x00, 0x00, 0x00, 0x00, 0x00, 0x00, 0x00, 0x00, 0x00, 0x00, 0x00,
  0x00, 0x00, 0x3e, 0x00, 0x00, 0x00, 0x00, 0x00, 0x00, 0x00, 0x00, 0x00, 0x00, 0x00, 0x00, 0x00,
  0x00, 0x00, 0x3f, 0x80, 0x00, 0x00, 0x00, 0x00, 0x00, 0x00, 0x00, 0x00, 0x00, 0x00, 0x00, 0x00,
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  0x00, 0x00, 0x00, 0x00, 0x00, 0x00, 0x00, 0x00, 0x00, 0x00, 0x00, 0x00, 0x00, 0x00, 0x00, 0x00
};
#define LOGO_WIDTH 128
#define LOGO_HEIGHT 64

int JoystickVal;
int ButtonVal;
bool status_up = false;
bool status_down = false;
bool status_push = false;
bool status_buttonA = false;
bool status_buttonB = false;
int menuIndex = 0;
const int menuCount = 3;
String menuItems[menuCount] = {"USER INFO", "GAME", "LOGO"};
// хэрэглэгчийн нэр
String username = "";
int charIndex = 0;
const char chars[] = "ABCDEFGHIJKLMNOPQRSTUVWXYZ_ ";
const int charCount = sizeof(chars) - 1;

// Шинэ хувьсагчид
unsigned long buttonPressTime = 0;
bool buttonAPressed = false;
bool buttonBPressed = false;
bool inUserNameEdit = false;
bool fromUserInfo = false;
bool usernameSaved = false;
//==============================================================
// DINO.INO-оос ирсэн тоглоомын тодорхойлолт ба графикууд
//==============================================================

// Chrome диногийн хэмжээ
#define DINO_WIDTH 24
#define DINO_HEIGHT 22
#define DINO_SIT_WIDTH 30
#define DINO_SIT_HEIGHT 15
#define DINO_INIT_X 10
#define DINO_INIT_Y 38
#define DINO_SIT_Y 46  // Суусан байрлалд бага зэрэг доош

// Сагсны хэмжээ
#define CACTUS_SMALL_WIDTH 22
#define CACTUS_BIG_WIDTH 27
#define CACTUS_A_WIDTH 23
#define CACTUS_B_WIDTH 27
#define CACTUS_HEIGHT 23
#define CACTUS_Y 41

// Шувууны хэмжээ
#define BIRD_WIDTH 23
#define BIRD_HEIGHT 20
#define BIRD_Y_TOP 15     // Дээд түвшин
#define BIRD_Y_MID 25     // Дунд түвшин
#define BIRD_Y_BOTTOM 35  // Доод түвшин

// Үсрэлтийн параметрүүд
#define INITIAL_JUMP_VELOCITY -10
#define NORMAL_GRAVITY 1.1
#define FAST_FALL_GRAVITY 3.0

// Бусад параметрүүд
#define GROUND_Y 47
#define MIN_CACTUS_DISTANCE 150
#define MIN_BIRD_DISTANCE 200
#define MIN_BIRD_CACTUS_DISTANCE 80
#define SPAWN_DISTANCE 180
#define SPEED_INCREASE_INTERVAL 10000

// Тоглоомын графикууд
static const unsigned char PROGMEM GAME_FIRST[] = {
  0x00, 0x00, 0x00, 0x00, 0x00, 0x00, 0x00, 0x00, 0x00, 0x00, 0x00, 0x00, 0x00, 0x00, 0x00, 0x00,
  0x00, 0x00, 0x00, 0x00, 0x00, 0x00, 0x00, 0x00, 0x00, 0x00, 0x00, 0x00, 0x00, 0x00, 0x00, 0x00,
  0x00, 0x00, 0x00, 0x00, 0x00, 0x00, 0x00, 0x00, 0x00, 0x00, 0x00, 0x00, 0x00, 0x00, 0x00, 0x00,
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  0x00, 0x00, 0x00, 0x00, 0x00, 0x00, 0x00, 0x00, 0x00, 0x00, 0x00, 0x00, 0x00, 0x00, 0x00, 0x00
};
static const unsigned char PROGMEM dino1[] = {
  0x10, 0x00, 0x00, 0x38, 0x00, 0x00, 0x48, 0x00, 0x00, 0x90, 0x00, 0x00, 0xa0, 0x02, 0x10, 0xa0,
  0x07, 0x38, 0xb0, 0x0d, 0xec, 0x90, 0x08, 0x06, 0xd8, 0x1d, 0x0b, 0x4c, 0x08, 0x22, 0x67, 0xfc,
  0x53, 0x30, 0x18, 0x02, 0x18, 0x00, 0x04, 0x08, 0x00, 0x08, 0x08, 0x00, 0x18, 0x18, 0x00, 0x10,
  0x20, 0x00, 0x30, 0x20, 0x00, 0x20, 0x1f, 0xff, 0xe0, 0x19, 0x86, 0x60, 0x33, 0x03, 0x30, 0x66,
  0x01, 0x98
};
static const unsigned char PROGMEM dino2[] = {
  0x10, 0x00, 0x00, 0x38, 0x00, 0x00, 0x48, 0x00, 0x00, 0x90, 0x00, 0x00, 0xa0, 0x02, 0x10, 0xa0,
  0x07, 0x38, 0xb0, 0x0d, 0xec, 0x90, 0x08, 0x06, 0xd8, 0x1d, 0x0b, 0x4c, 0x08, 0x22, 0x67, 0xfc,
  0x53, 0x30, 0x18, 0x02, 0x18, 0x00, 0x04, 0x08, 0x00, 0x08, 0x08, 0x00, 0x18, 0x18, 0x00, 0x10,
  0x20, 0x00, 0x30, 0x20, 0x00, 0x20, 0x1f, 0xff, 0xe0, 0x19, 0x83, 0x60, 0x0c, 0xc6, 0xc0, 0x06,
  0x6d, 0x80
};
static const unsigned char PROGMEM dinoDIE[] = {
  0x0d, 0x86, 0xc0, 0x02, 0x01, 0x00, 0x0d, 0x86, 0xc0, 0x1f, 0xff, 0xe0, 0x20, 0x00, 0x20, 0x20,
  0x00, 0x30, 0x18, 0x00, 0x10, 0x48, 0x00, 0x18, 0xe8, 0x00, 0x08, 0xb8, 0x00, 0x04, 0x90, 0x18,
  0x02, 0xc7, 0xfc, 0x53, 0xcc, 0x08, 0x22, 0x78, 0x1d, 0x0b, 0x00, 0x08, 0x06, 0x00, 0x0d, 0xec,
  0x00, 0x07, 0x38, 0x00, 0x02, 0x10
};
static const unsigned char PROGMEM dinoDIE_sitdown[] = {
  0x0d, 0x86, 0xc0, 0x02, 0x01, 0x00, 0x0d, 0x86, 0xc0, 0x1f, 0xff, 0xe0, 0x20, 0x00, 0x20, 0x20,
  0x00, 0x30, 0x18, 0x00, 0x10, 0x48, 0x00, 0x18, 0xe8, 0x00, 0x08, 0xb8, 0x00, 0x04, 0x90, 0x18,
  0x02, 0xc7, 0xfc, 0x53, 0xcc, 0x08, 0x22, 0x78, 0x1d, 0x0b, 0x00, 0x08, 0x06, 0x00, 0x0d, 0xec,
  0x00, 0x07, 0x38, 0x00, 0x02, 0x10
};
static const unsigned char PROGMEM dino1_sitdown[] = {
  0x00, 0x00, 0x04, 0x40, 0x00, 0x00, 0x0e, 0xe0, 0x00, 0x00, 0x1b, 0xb0, 0x0e, 0x00, 0x30, 0x18,
  0x1b, 0xfc, 0x64, 0x28, 0x20, 0x07, 0xf0, 0x8c, 0x2f, 0x03, 0x21, 0x48, 0x51, 0x00, 0x30, 0x0c,
  0xa1, 0x00, 0x00, 0x18, 0xc3, 0x00, 0x00, 0x70, 0x04, 0x00, 0x03, 0xc0, 0x04, 0x00, 0x06, 0x00,
  0x03, 0xff, 0xfc, 0x00, 0x03, 0x30, 0xcc, 0x00, 0x06, 0x60, 0x66, 0x00
};
static const unsigned char PROGMEM dino2_sitdown[] = {
  0x00, 0x00, 0x04, 0x40, 0x00, 0x00, 0x0e, 0xe0, 0x00, 0x00, 0x1b, 0xb0, 0x0e, 0x00, 0x30, 0x18,
  0x1b, 0xfc, 0x64, 0x28, 0x20, 0x07, 0xf0, 0x8c, 0x2f, 0x03, 0x21, 0x48, 0x51, 0x00, 0x30, 0x0c,
  0xa1, 0x00, 0x00, 0x18, 0xc3, 0x00, 0x00, 0x70, 0x04, 0x00, 0x03, 0xc0, 0x04, 0x00, 0x06, 0x00,
  0x03, 0xff, 0xfc, 0x00, 0x03, 0x30, 0xcc, 0x00, 0x01, 0x99, 0x98, 0x00
};
static const unsigned char PROGMEM pterodactyl[] = {
  0x00, 0x00, 0x00, 0x00, 0x00, 0x00, 0x00, 0x00, 0x00, 0x06, 0x00, 0x00, 0x09, 0x00, 0x00, 0x11,
  0x00, 0x00, 0x20, 0x80, 0x00, 0x40, 0xfe, 0x00, 0x80, 0x01, 0x00, 0xfe, 0x00, 0xfe, 0x01, 0x00,
  0x02, 0x00, 0x80, 0x1c, 0x00, 0x80, 0x04, 0x00, 0x80, 0x38, 0x00, 0x87, 0xc0, 0x00, 0x88, 0x00,
  0x00, 0x90, 0x00, 0x00, 0x90, 0x00, 0x00, 0xa0, 0x00, 0x00, 0x40, 0x00
};
static const unsigned char PROGMEM pterodacty2[] = {
  0x00, 0x80, 0x00, 0x01, 0x40, 0x00, 0x01, 0x20, 0x00, 0x07, 0x10, 0x00, 0x09, 0x88, 0x00, 0x11,
  0x84, 0x00, 0x20, 0x82, 0x00, 0x40, 0x81, 0x00, 0x80, 0x01, 0x00, 0x7e, 0x00, 0xfc, 0x01, 0x00,
  0x02, 0x00, 0x80, 0x1c, 0x00, 0x40, 0x04, 0x00, 0x20, 0x38, 0x00, 0x1f, 0xe0, 0x00, 0x00, 0x00,
  0x00, 0x00, 0x00, 0x00, 0x00, 0x00, 0x00, 0x00, 0x00, 0x00, 0x00, 0x00
};
static const unsigned char PROGMEM cactus_small[] = {
  0x03, 0x00, 0x00, 0x04, 0x80, 0x00, 0x08, 0x40, 0x00, 0x08, 0x40, 0x00, 0x08, 0x40, 0x00, 0x08,
  0x50, 0x40, 0x28, 0x68, 0xa0, 0x58, 0x45, 0x90, 0x88, 0x46, 0x90, 0x88, 0x44, 0x9c, 0x88, 0x44,
  0x92, 0x88, 0x44, 0x92, 0x88, 0x44, 0x92, 0x88, 0x44, 0x92, 0x80, 0x0c, 0x92, 0x40, 0x12, 0x12,
  0x20, 0x61, 0x84, 0x18, 0x40, 0x98, 0x08, 0x40, 0x90, 0x08, 0x40, 0x90, 0x08, 0x40, 0x90, 0x08,
  0x40, 0x90, 0x38, 0x77, 0x90, 0x20, 0x55, 0x9c, 0x3f, 0xf7, 0xf4, 0x02, 0x80, 0x1c
};
static const unsigned char PROGMEM cactus_big[] = {
  0x03, 0x00, 0x18, 0x00, 0x04, 0x80, 0x24, 0x00, 0x08, 0x40, 0x42, 0x00, 0x08, 0x41, 0x42, 0x00,
  0x08, 0x42, 0xc2, 0x00, 0x08, 0x54, 0x42, 0x80, 0x28, 0x6c, 0x43, 0x40, 0x58, 0x44, 0x42, 0x20,
  0x88, 0x44, 0x42, 0x20, 0x88, 0x44, 0x42, 0x20, 0x88, 0x44, 0x42, 0x20, 0x88, 0x44, 0x02, 0x20,
  0x88, 0x46, 0x02, 0x20, 0x88, 0x45, 0x00, 0x20, 0x80, 0x08, 0xc0, 0x40, 0x40, 0x10, 0x40, 0x80,
  0x20, 0x60, 0x43, 0x00, 0x18, 0x40, 0x42, 0x00, 0x08, 0x40, 0x42, 0x00, 0x08, 0x40, 0x42, 0x00,
  0x08, 0x40, 0x42, 0x00, 0x08, 0x40, 0x42, 0x00, 0x38, 0x71, 0xc2, 0x00, 0x20, 0x51, 0x03, 0x80,
  0x3f, 0xf1, 0xfe, 0x80, 0x02, 0x80, 0xa3, 0x80
};
static const unsigned char PROGMEM cactus_A[] = {
  0x00, 0x01, 0x80, 0x00, 0x02, 0x40, 0x00, 0x04, 0x20, 0x00, 0x04, 0x20, 0x00, 0x04, 0x20, 0x08,
  0x04, 0x28, 0x14, 0x14, 0x34, 0x32, 0x2c, 0x22, 0x52, 0x44, 0x22, 0x93, 0xc4, 0x22, 0x92, 0x44,
  0x22, 0x92, 0x44, 0x22, 0x92, 0x44, 0x22, 0x92, 0x44, 0x22, 0x92, 0x40, 0x04, 0x42, 0x60, 0x08,
  0x30, 0x90, 0x30, 0x13, 0x0c, 0x20, 0x12, 0x04, 0x20, 0x12, 0x04, 0x20, 0x12, 0x04, 0x20, 0x12,
  0x04, 0x20, 0xf2, 0x1c, 0x38, 0xb3, 0x90, 0x28, 0xfe, 0x9f, 0xf8, 0x03, 0x81, 0x40
};
static const unsigned char PROGMEM cactus_B[] = {
  0x00, 0x00, 0x00, 0x00, 0x00, 0x00, 0x00, 0x00, 0x00, 0x00, 0x00, 0x00, 0x00, 0x00, 0x00, 0x00,
  0x00, 0x00, 0x00, 0x00, 0x00, 0x00, 0x00, 0x00, 0x08, 0x00, 0x06, 0x00, 0x14, 0x0a, 0x29, 0x00,
  0x13, 0x31, 0x59, 0x80, 0x12, 0xd1, 0x49, 0x40, 0x32, 0x51, 0xc9, 0x20, 0x52, 0x51, 0x49, 0x20,
  0x92, 0x51, 0x49, 0x20, 0x92, 0x51, 0x49, 0x20, 0x92, 0x51, 0x49, 0x20, 0x90, 0xd1, 0x61, 0x20,
  0x93, 0x51, 0x58, 0x40, 0x42, 0x41, 0x49, 0x80, 0x32, 0x20, 0x49, 0x00, 0x12, 0x10, 0x89, 0x00,
  0x12, 0x11, 0x09, 0x00, 0x12, 0x11, 0x09, 0x00, 0x12, 0x11, 0x09, 0x00, 0x12, 0x71, 0xe9, 0xe0,
  0x1f, 0xdf, 0xaf, 0xa0, 0x02, 0xf0, 0xe5, 0xe0
};
static const unsigned char PROGMEM cloud1[] = {
  0x00, 0x00, 0x00, 0x00, 0x00, 0x00, 0x00, 0x00, 0x00, 0x00, 0x00, 0x00, 0x00, 0x00, 0x00, 0x00,
  0x6e, 0x00, 0x00, 0x67, 0x00, 0x06, 0x01, 0xc0, 0x18, 0x00, 0x20, 0x10, 0x00, 0x20, 0x60, 0x0c,
  0x10, 0xc1, 0x0c, 0x0c, 0xc3, 0x00, 0x02, 0x80, 0x00, 0x01, 0x00, 0x00, 0x43, 0x00, 0x00, 0xc3,
  0x80, 0x00, 0x01, 0x80, 0x00, 0x00, 0xc0, 0x3e, 0x01, 0xf0, 0xff, 0x86, 0x0f, 0x00, 0x48, 0x00,
  0x00, 0x00
};
static const unsigned char PROGMEM cloud2[] = {
  0x00, 0x00, 0x00, 0x00, 0x00, 0x00, 0x00, 0x00, 0x00, 0x00, 0x7f, 0x00, 0x01, 0xd9, 0x80, 0x04,
  0x00, 0xe0, 0x18, 0x00, 0x3c, 0x00, 0x00, 0x06, 0x60, 0x00, 0x02, 0xc0, 0x01, 0x02, 0x80, 0xc3,
  0x07, 0x80, 0x80, 0x07, 0x80, 0x80, 0x03, 0x00, 0x00, 0x01, 0xf0, 0x00, 0x00, 0xfc, 0x00, 0x60,
  0x06, 0x00, 0x70, 0x03, 0xc0, 0x01, 0x00, 0x78, 0x03, 0x00, 0x0f, 0xe6, 0x00, 0x00, 0x3c, 0x00,
  0x00, 0x00
};
static const unsigned char PROGMEM cloud3[] = {
  0x00, 0x00, 0x00, 0x00, 0x00, 0x00, 0x07, 0xe0, 0x00, 0x38, 0x38, 0x00, 0x20, 0x08, 0x00, 0x60,
  0x0c, 0x00, 0xc0, 0x07, 0xf0, 0x82, 0x00, 0x18, 0x82, 0x00, 0x04, 0x82, 0x06, 0x06, 0x00, 0x06,
  0x02, 0x00, 0x00, 0x03, 0x00, 0x00, 0x03, 0x00, 0x20, 0x02, 0x81, 0xe0, 0x7a, 0x80, 0x00, 0xc4,
  0x80, 0x00, 0x0c, 0xe0, 0x00, 0xfc, 0xff, 0xff, 0x80, 0x00, 0x00, 0x00, 0x00, 0x00, 0x00, 0x00,
  0x00, 0x00
};
//==============================================================
// DINO.INO-оос ирсэн тоглоомын функцүүд
//==============================================================
void play();
void introMessage();
void displayScore(int score, int distance);
void gameOver(int score, int distance);
int getBirdY(int bird_level);
bool checkCollision(int16_t dino_y, bool isSitting, int16_t cactus_x, int cactus_type, int16_t bird_x, bool bird_active, int bird_level);
int getCactusWidth(int cactus_type);
const unsigned char* getCactusBitmap(int cactus_type);
void drawCactus(int16_t x, int cactus_type);
void drawBird(int16_t x, int frame, int bird_level);
void introMessage() {
  display.clearDisplay();
  display.drawBitmap(0, 0, GAME_FIRST, 128, 64, SSD1306_WHITE);
  display.display();
}

void displayScore(int score, int distance) {
  display.setTextSize(1);
  display.setTextColor(SSD1306_WHITE);
  display.setCursor(70, 5);
  display.print("Dist: ");
  display.print(distance);
}

void gameOver(int score, int distance) {
  // Game over sound
  tone(BUZZER_PIN, NOTE_OVER_1, 150);
  delay(160);
  tone(BUZZER_PIN, NOTE_OVER_2, 150);
  delay(160);
  tone(BUZZER_PIN, NOTE_OVER_3, 200);
  delay(200);
  noTone(BUZZER_PIN);

  display.clearDisplay();
  display.setTextSize(2);
  display.setTextColor(SSD1306_WHITE);
  display.setCursor(10, 5);
  display.println("GAME OVER");
  display.setTextSize(1);
  // display.setCursor(10, 25);
  // display.print("Score: ");
  // display.print(score);

  display.setCursor(10, 25);
  display.print("Distance: ");
  if(distance==113){
    display.print("SONSDOG NOM");
  display.print("m");
  }
  display.print(distance);
  display.print("m");

  display.setCursor(1, 50);
  // **ШИНЭЧИЛСЭН ХЭСЭГ: Хэрэглэгчид заавар өгөх**
  // display.println("A=AGAIN, B=BACK");

  display.display();
  // Дахин тоглох эсвэл гарахыг хүлээх
  while(true){
    readInputs();
    if(status_buttonA || status_push || status_up || status_down){
      play();
      // Тоглоомыг дахин эхлүүлэх
      return;
      // Энэ gameOver функцээс гарах (шинэ тоглоом дууссаны дараа)
    }
    // **ШИНЭЧИЛСЭН ХЭСЭГ: B товч дарвал гарах**
    if(status_buttonB){
      return;
      // Үндсэн цэс рүү буцах
    }
    delay(100);
  }
}

int getBirdY(int bird_level) {
  switch (bird_level) {
    case 0: return BIRD_Y_TOP;
    case 1: return BIRD_Y_MID;
    case 2: return BIRD_Y_BOTTOM;
    default: return BIRD_Y_MID;
  }
}

int getCactusWidth(int cactus_type) {
  switch (cactus_type) {
    case 0: return CACTUS_SMALL_WIDTH;
    case 1: return CACTUS_BIG_WIDTH;
    case 2: return CACTUS_A_WIDTH;
    case 3: return CACTUS_B_WIDTH;
    default: return CACTUS_SMALL_WIDTH;
  }
}

const unsigned char* getCactusBitmap(int cactus_type) {
  switch (cactus_type) {
    case 0: return cactus_small;
    case 1: return cactus_big;
    case 2: return cactus_A;
    case 3: return cactus_B;
    default: return cactus_small;
  }
}

void drawCactus(int16_t x, int cactus_type) {
  int width = getCactusWidth(cactus_type);
  const unsigned char* bitmap = getCactusBitmap(cactus_type);
  display.drawBitmap(x, CACTUS_Y, bitmap, width, CACTUS_HEIGHT, SSD1306_WHITE);
}

void drawBird(int16_t x, int frame, int bird_level) {
  const unsigned char* bitmap = (frame == 0) ?
  pterodactyl : pterodacty2;
  int bird_y = getBirdY(bird_level);
  display.drawBitmap(x, bird_y, bitmap, BIRD_WIDTH, BIRD_HEIGHT, SSD1306_WHITE);
}


bool checkCollision(int16_t dino_y, bool isSitting, int16_t cactus_x, int cactus_type, int16_t bird_x, bool bird_active, int bird_level) {
  int dino_height = isSitting ?
  DINO_SIT_HEIGHT : DINO_HEIGHT;
  int dino_actual_y = isSitting ? DINO_SIT_Y : dino_y;
  if (cactus_x < DINO_INIT_X + DINO_WIDTH - 5 && cactus_x + getCactusWidth(cactus_type) > DINO_INIT_X + 3) {
    if (dino_actual_y + dino_height > CACTUS_Y + 2) {
      return true;
    }
  }

  if (bird_active && bird_x < DINO_INIT_X + DINO_WIDTH - 5 && bird_x + BIRD_WIDTH > DINO_INIT_X + 3) {
    int bird_y = getBirdY(bird_level);
    bool head_collision = (dino_actual_y < bird_y + BIRD_HEIGHT - 2) && (dino_actual_y + 10 > bird_y + 2);
    bool tail_collision = (dino_actual_y + dino_height > bird_y + 2) && (dino_actual_y + dino_height - 5 < bird_y + BIRD_HEIGHT - 2);
    if (head_collision || tail_collision) {
      return true;
    }
  }

  return false;
}

void play() {
  introMessage();
  // Game start sound
  tone(BUZZER_PIN, NOTE_START_1, 100);
  delay(100);
  tone(BUZZER_PIN, NOTE_START_2, 100);
  delay(100);
  noTone(BUZZER_PIN);

  delay(1500);

  display.clearDisplay();
  display.display();

  int16_t cactus_x = SCREEN_WIDTH + SPAWN_DISTANCE;
  int16_t cactus1_x = SCREEN_WIDTH + SPAWN_DISTANCE * 2;
  int16_t bird_x = SCREEN_WIDTH + SPAWN_DISTANCE + 100;
  bool bird_active = false;
  int bird_frame = 0;
  int bird_level = 1;

  int cactus_type = random(0, 4);
  int cactus_type1 = random(0, 4);
  int16_t dino_y = DINO_INIT_Y;
  bool isJumping = false;
  bool isSitting = false;
  bool isFastFalling = false;
  float dinoVelocity = 0;
  float currentGravity = NORMAL_GRAVITY;
  bool isDead = false;
  unsigned long deathTime = 0;

  int score = 0;
  int distance = 0;
  int dinoFrame = 0;
  int dino_sit_frame = 0;

  unsigned long lastADCRead = millis();
  unsigned long lastFrameChange = millis();
  unsigned long lastSpeedIncrease = millis();
  int gameSpeed = 6;
  while (true) {
    unsigned long currentTime = millis();
    // **ШИНЭЧИЛСЭН ХЭСЭГ: Тоглоомын явцад 'B' товчийг удаан дарж гарах**
    readInputs();
    if(status_buttonB){
        unsigned long pressTime = millis();
        while(status_buttonB){
            readInputs();
            if (millis() - pressTime > 2000) { // 2 секунд дарахад
                return;
                // Тоглоомоос гарч үндсэн цэс рүү буцна
            }
        }
    }

    if (!isDead) {
      if (currentTime - lastADCRead > 50) {
        lastADCRead = currentTime;
        if (status_up && !isJumping && !isSitting && dino_y == DINO_INIT_Y) {
          isJumping = true;
          isFastFalling = false;
          dinoVelocity = INITIAL_JUMP_VELOCITY;
          currentGravity = NORMAL_GRAVITY;
        }

        if (status_down) {
          if (!isJumping) {
            isSitting = true;
          } else if (isJumping) {
            isFastFalling = true;
            currentGravity = FAST_FALL_GRAVITY;
          }
        } else {
          if (isJumping) {
            isFastFalling = false;
            currentGravity = NORMAL_GRAVITY;
          }
          if (isSitting && !isJumping) {
            isSitting = false;
          }
        }
      }

      if (currentTime - lastFrameChange > 150) {
        lastFrameChange = currentTime;
        if (isSitting && !isJumping) {
          dino_sit_frame = 1 - dino_sit_frame;
        } else if (!isJumping && !isSitting) {
          dinoFrame = 1 - dinoFrame;
        }

        if (bird_active) {
          bird_frame = 1 - bird_frame;
        }
      }

      if (isJumping) {
        dino_y += dinoVelocity;
        dinoVelocity += currentGravity;

        if (dino_y >= DINO_INIT_Y) {
          dino_y = DINO_INIT_Y;
          isJumping = false;
          isFastFalling = false;
          dinoVelocity = 0;
          currentGravity = NORMAL_GRAVITY;
        }
      }

      distance += 1;
      score = distance / 10;
      if (currentTime - lastSpeedIncrease > SPEED_INCREASE_INTERVAL) {
        if (gameSpeed < 15) {
          gameSpeed++;
          lastSpeedIncrease = currentTime;
        }
      }
      
      if (checkCollision(dino_y, isSitting, cactus_x, cactus_type, bird_x, bird_active, bird_level) || checkCollision(dino_y, isSitting, cactus1_x, cactus_type1, bird_x, bird_active, bird_level)) {
        isDead = true;
        deathTime = currentTime;
      }
    } else {
      if (currentTime - deathTime > 1000) {
        break;
      }
    }

    display.clearDisplay();
    displayScore(score, distance);
    drawCactus(cactus_x, cactus_type);
    drawCactus(cactus1_x, cactus_type1);
    if (bird_active) {
      drawBird(bird_x, bird_frame, bird_level);
    }

    if (isDead) {
      if (isSitting) {
        display.drawBitmap(DINO_INIT_X, DINO_SIT_Y, dinoDIE_sitdown, DINO_SIT_WIDTH, DINO_SIT_HEIGHT, SSD1306_WHITE);
      } else {
        display.drawBitmap(DINO_INIT_X, dino_y, dinoDIE, DINO_WIDTH, DINO_HEIGHT, SSD1306_WHITE);
      }
    } else if (isSitting) {
      const unsigned char* sit_bitmap = (dino_sit_frame == 0) ?
      dino1_sitdown : dino2_sitdown;
      display.drawBitmap(DINO_INIT_X, DINO_SIT_Y, sit_bitmap, DINO_SIT_WIDTH, DINO_SIT_HEIGHT, SSD1306_WHITE);
    } else if (isJumping) {
      display.drawBitmap(DINO_INIT_X, dino_y, dino1, DINO_WIDTH, DINO_HEIGHT, SSD1306_WHITE);
    } else {
      display.drawBitmap(DINO_INIT_X, dino_y, dinoFrame == 0 ? dino1 : dino2, DINO_WIDTH, DINO_HEIGHT, SSD1306_WHITE);
    }

    if (!isDead) {
      cactus_x -= gameSpeed;
      cactus1_x -= gameSpeed;
      if (bird_active) {
        bird_x -= gameSpeed;
      }

      if (cactus_x < -getCactusWidth(cactus_type)) {
        cactus_x = SCREEN_WIDTH + random(SPAWN_DISTANCE, SPAWN_DISTANCE + 50);
        cactus_type = random(0, 4);
      }
      if (cactus1_x < -getCactusWidth(cactus_type1)) {
        cactus1_x = SCREEN_WIDTH + random(SPAWN_DISTANCE, SPAWN_DISTANCE + 50);
        cactus_type1 = random(0, 4);
      }

      if (!bird_active && cactus_x < 0 && cactus1_x < 0 && random(0, 100) < 30) {
        bird_active = true;
        bird_x = SCREEN_WIDTH + SPAWN_DISTANCE;
        bird_level = random(0, 3);
      } else if (bird_active && bird_x < -BIRD_WIDTH) {
        bird_active = false;
      }
    }

    display.display();
    delay(16);
  }

  gameOver(score, distance);
}


//==============================================================
// CAT3.INO-оос ирсэн үндсэн функцүүд
//==============================================================

void setup() {
  Serial.begin(115200);
  EEPROM.begin(EEPROM_SIZE);
  // // EEPROM-ийг бүхэлд нь цэвэрлэнэ
  // for (int i = 0; i < EEPROM_SIZE; i++) {
  //   EEPROM.write(i, 0);
  // }
  EEPROM.commit();

  EEPROM.commit();
  readUsernameFromEEPROM(); // **Өөрчлөлт: Анхдагч нэрийг тохируулах**
   if (username == "") {
    username = "MN/CERT 2025";
    saveUsernameToEEPROM(); // Шинэ нэрийг EEPROM-д хадгална
  }

  pinMode(BUZZER_PIN, OUTPUT); // Buzzer PIN-г OUTPUT болгож тохируулах

  analogReadResolution(ADC_BITS);
  analogSetPinAttenuation(ADC_PIN, ADC_ATTEN);
  analogSetPinAttenuation(ADC_PIN1, ADC_ATTEN);
  if (!display.begin(SSD1306_SWITCHCAPVCC, 0x3C)) {
    Serial.println(F("SSD1306 allocation failed"));
    for (;;);
  }
  display.clearDisplay();
  display.display();
}

void readUsernameFromEEPROM() {
  username = "";
  for (int i = 0; i < EEPROM_SIZE; i++) {
    char c = EEPROM.read(USERNAME_ADDR + i);
    if (c == 0 || c == 255) break;
    username += c;
  }
  
  // **ШИНЭЧИЛСЭН ХЭСЭГ: Хэрэв нэр байхгүй бол анхдагч нэр оноох**
  if (username.length() == 0) {
    username = "MN/CERT 2025";
    usernameSaved = false; // Энэ бол хадгалагдаагүй, зүгээр анхдагч утга
  } else {
    usernameSaved = true;
  }
}

void saveUsernameToEEPROM() {

  for (int i = 0; i < username.length(); i++) {
    EEPROM.write(USERNAME_ADDR + i, username.charAt(i));
  }
  EEPROM.write(USERNAME_ADDR + username.length(), '\0'); // Утасны төгсгөлийг тэмдэглэнэ
  EEPROM.commit();
  for (int i = 0; i < EEPROM_SIZE; i++) {
    EEPROM.write(USERNAME_ADDR + i, 0);
  }
  for (int i = 0; i < username.length() && i < EEPROM_SIZE - 1; i++) {
    EEPROM.write(USERNAME_ADDR + i, username[i]);
  }
  EEPROM.write(USERNAME_ADDR + username.length(), 0);
  EEPROM.commit();
  usernameSaved = true;
}

void readInputs() {
  JoystickVal = analogRead(ADC_PIN);
  ButtonVal = analogRead(ADC_PIN1);
  status_up = false;
  status_down = false;
  status_push = false;
  status_buttonA = false;
  status_buttonB = false;
  if (0 < JoystickVal && JoystickVal < 100) status_up = true;
  if (3600 < JoystickVal && JoystickVal < 3899) status_down = true;

  if (2800 < JoystickVal && JoystickVal < 3100) {
    status_push = true;
    tone(BUZZER_PIN, NOTE_PUSH, 50); // Joystick дарагдахад дуугарах
  }

  if (ButtonVal < 100) {
    status_buttonA = true;
    tone(BUZZER_PIN, NOTE_BUTTON_A, 50); // A товч дарагдахад дуугарах
  }
  
  if (2000 < ButtonVal && ButtonVal < 2500) {
    status_buttonB = true;
    tone(BUZZER_PIN, NOTE_BUTTON_B, 50); // B товч дарагдахад дуугарах
  }
}

void drawMenu() {
  display.clearDisplay();
  display.setFont();
  display.setTextSize(1);
  for (int i = 0; i < menuCount; i++) {
    int y = i * 16;
    if (i == menuIndex) {
      display.fillRect(0, y, SCREEN_WIDTH, 16, SSD1306_WHITE);
      display.setTextColor(SSD1306_BLACK, SSD1306_WHITE);
      display.setCursor(5, y + 4);
      display.println(menuItems[i]);
      display.setCursor(6, y + 4);
      display.println(menuItems[i]);
    } else {
      display.setTextColor(SSD1306_WHITE, SSD1306_BLACK);
      display.setCursor(5, y + 4);
      display.println(menuItems[i]);
    }
  }
  display.display();
}

void showUserInfo() {
  bool inUserInfo = true;
  while (inUserInfo) {
    readInputs();
    
    display.clearDisplay();
    display.setFont();
    display.setTextSize(1);
    display.setTextColor(SSD1306_WHITE);
    // **ШИНЭЧИЛСЭН ХЭСЭГ: Нэр байвал (анхдагч эсвэл хадгалсан) харуулах**
    if (username.length() > 0) {
      display.setCursor(0, 20);
      display.setTextSize(2);
      
      String displayName = username;
      int textWidth = displayName.length() * 12;
      if (textWidth > SCREEN_WIDTH) {
        display.setTextSize(1);
        textWidth = displayName.length() * 6;
      }
      
      int xPos = (SCREEN_WIDTH - textWidth) / 2;
      if (xPos < 0) xPos = 0;
      
      display.setCursor(xPos, 25);
      display.println(displayName);
    } else {
      // Энэ хэсэгт орох ёсгүй ч, алдаанаас сэргийлж үлдээв
      display.setCursor(0, 30);
      display.setTextSize(2);
      display.setCursor(40, 25);
      display.println("NO NAME");
    }
    
    display.display();
    if (status_buttonA) {
      unsigned long pressTime = millis();
      while (status_buttonA) {
        readInputs();
        if (millis() - pressTime >= 2000) {
          enterUserName();
          break;
        }
        delay(100);
      }
    }
    
    if (status_buttonB) {
      inUserInfo = false;
    }
    
    delay(100);
  }
}

void enterUserName() {
  bool editing = true;
  unsigned long lastInputTime = millis();
  bool cursorVisible = true;
  unsigned long cursorBlinkTime = millis();
  
  fromUserInfo = true;
  inUserNameEdit = true;
  const int visibleChars = 10;
  int scrollOffset = 0;

  while (editing) {
    readInputs();
    unsigned long currentTime = millis();
    if (currentTime - cursorBlinkTime > 500) {
      cursorVisible = !cursorVisible;
      cursorBlinkTime = currentTime;
    }
    
    if (status_up) {
      charIndex--;
      if (charIndex < 0) charIndex = charCount - 1;
      lastInputTime = currentTime;
      if (charIndex < scrollOffset) {
        scrollOffset = charIndex;
      } else if (charIndex >= scrollOffset + visibleChars) {
        scrollOffset = charIndex - visibleChars + 1;
      }
    }
    
    if (status_down) {
      charIndex++;
      if (charIndex >= charCount) charIndex = 0;
      lastInputTime = currentTime;
      if (charIndex < scrollOffset) {
        scrollOffset = charIndex;
      } else if (charIndex >= scrollOffset + visibleChars) {
        scrollOffset = charIndex - visibleChars + 1;
      }
    }
    
    if (status_buttonA && !buttonAPressed) {
      buttonAPressed = true;
      buttonPressTime = currentTime;
    }
    
    if (buttonAPressed) {
      if (!status_buttonA) {
        username += chars[charIndex];
        buttonAPressed = false;
      } 
      else if (currentTime - buttonPressTime >= 2000) {
        if (username.length() > 0) {
          saveUsernameToEEPROM();
        }
        editing = false;
        inUserNameEdit = false;
      }
    }
    
    if (status_buttonB && !buttonBPressed) {
      buttonBPressed = true;
      buttonPressTime = currentTime;
    }
    
    if (buttonBPressed) {
      if (!status_buttonB) {
        if (username.length() > 0) {
          username.remove(username.length() - 1);
        }
        buttonBPressed = false;
      }
      else if (currentTime - buttonPressTime >= 2000) {
        readUsernameFromEEPROM();
        // Цуцалсан үед хуучин нэрийг сэргээх
        editing = false;
        inUserNameEdit = false;
      }
    }
    
    if (status_push) {
      username += chars[charIndex];
      lastInputTime = currentTime;
      delay(200); // Нэг даралтаар олон үсэг орохоос сэргийлэх
    }

    display.clearDisplay();
    display.setFont();
    display.setTextSize(1);
    display.setTextColor(SSD1306_WHITE);
    display.setCursor(0, 0);
    if (username.length() == 0) {
      display.setCursor(40, 0);
      display.print("Enter name:");
    } else {
      String displayName = username;
      if (username.length() > 16) {
        displayName = username.substring(0, 16);
      }
      int textWidth = (displayName.length() + 6) * 6;
      int xPos = (SCREEN_WIDTH - textWidth) / 2;
      display.setCursor(xPos < 0 ? 0 : xPos, 0);
      display.print("Name: ");
      display.println(displayName);
    }
    
    String charLine = "";
    for (int i = 0; i < visibleChars && (scrollOffset + i) < charCount; i++) {
      int idx = scrollOffset + i;
      if (idx == charIndex) {
        charLine += "[";
        charLine += chars[idx];
        charLine += "]";
      } else {
        charLine += " ";
        charLine += chars[idx];
        charLine += " ";
      }
      charLine += " ";
    }
    
    int lineWidth = charLine.length() * 6;
    int xPos = (SCREEN_WIDTH - lineWidth) / 2;
    if (xPos < 0) xPos = 0;
    
    display.setCursor(xPos, 20);
    display.println(charLine);
    String selectedText = "Selected: ";
    selectedText += chars[charIndex];
    if (cursorVisible) {
      selectedText += "_";
    }
    int selectedWidth = selectedText.length() * 6;
    xPos = (SCREEN_WIDTH - selectedWidth) / 2;
    display.setCursor(xPos, 35);
    display.println(selectedText);
    display.display();
    delay(100);
  }
}

void showLogo() {
  bool inLogo = true;
  unsigned long startTime = millis();
  while (inLogo) {
    readInputs();
    
    display.clearDisplay();
    display.drawBitmap(0, 15, logoBitmap, LOGO_WIDTH, LOGO_HEIGHT, SSD1306_WHITE);
    display.display();
    if (status_buttonB) {
      inLogo = false;
    }
    
    delay(100);
  }
}

void showPage(String title) {
  if (title == "USER INFO") {
    showUserInfo();
  } else if (title == "GAME") {
    play();
  } else if (title == "LOGO") {
    showLogo();
  }
}

void loop() {
  if (inUserNameEdit) {
     // Нэр засварлаж байх үед цэсийг зурахгүй
  } else {
    readInputs();
    if (status_up) {
      menuIndex--;
      if (menuIndex < 0) menuIndex = menuCount - 1;
    }
    if (status_down) {
      menuIndex++;
      if (menuIndex >= menuCount) menuIndex = 0;
    }

    if (status_push || status_buttonA) {
      showPage(menuItems[menuIndex]);
    }
    drawMenu();
  }

  delay(200);
}